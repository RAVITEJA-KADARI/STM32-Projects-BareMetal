# file: Free_RTOS_Leds_PE8_to_PE15.ioc
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FREERTOS.Tasks01=defaultTask,24,128,StartDefaultTask,Default,NULL,Dynamic,NULL,NULL;PE8,8,128,LED1,Default,NULL,Dynamic,NULL,NULL;PE9,8,128,LED2,Default,NULL,Dynamic,NULL,NULL;PE10,8,128,LED3,Default,NULL,Dynamic,NULL,NULL;PE11,16,128,LED4,Default,NULL,Dynamic,NULL,NULL;PE12,24,128,LED5,Default,NULL,Dynamic,NULL,NULL;PE13,32,128,LED6,Default,NULL,Dynamic,NULL,NULL;PE14,40,128,LED7,Default,NULL,Dynamic,NULL,NULL;PE15,48,128,LED8,Default,NULL,Dynamic,NULL,NULL
FREERTOS.configTOTAL_HEAP_SIZE=7000
FREERTOS.configUSE_NEWLIB_REENTRANT=1
Mcu.Family=STM32F3
Mcu.Name=STM32F303V(B-C)Tx
Mcu.Package=LQFP100
NVIC.PriorityGroup=NVIC_PRIORITYGROUP_4
NVIC.TIM6_DAC_IRQn=true\:15\:0\:false\:false\:true\:false\:false\:true\:true
NVIC.TimeBase=TIM6_DAC_IRQn
NVIC.TimeBaseIP=TIM6
PA13.Mode=Serial_Wire
PA13.Signal=SYS_JTMS-SWDIO
PA14.Mode=Serial_Wire
PA14.Signal=SYS_JTCK-SWCLK
PF0-OSC_IN.Mode=HSE-External-Oscillator
PF0-OSC_IN.Signal=RCC_OSC_IN
PF1-OSC_OUT.Mode=HSE-External-Oscillator
PF1-OSC_OUT.Signal=RCC_OSC_OUT
ProjectManager.HeapSize=0x200
ProjectManager.StackSize=0x400
ProjectManager.TargetToolchain=STM32CubeIDE
RCC.AHBFreq_Value=16000000
RCC.APB1Freq_Value=16000000
RCC.APB1TimFreq_Value=16000000
RCC.APB2Freq_Value=16000000
RCC.APB2TimFreq_Value=16000000
RCC.CortexFreq_Value=16000000
RCC.HCLKFreq_Value=16000000
RCC.HSI_VALUE=8000000
RCC.LSE_VALUE=32768
RCC.PLLSourceVirtual=RCC_PLLSOURCE_HSE
RCC.SYSCLKFreq_VALUE=16000000
RCC.SYSCLKSourceVirtual=RCC_SYSCLKSOURCE_PLLCLK
RCC.USBFreq_Value=16000000
VP_FREERTOS_VS_CMSIS_V2.Mode=CMSIS_V2
VP_SYS_VS_tim6.Mode=TIM6
board=custom

// file: Core/Src/main.c
/* USER CODE BEGIN Header */
/**
  ******************************************************************************
  * @file           : main.c
  * @brief          : Main program body
  ******************************************************************************
  * @attention
  *
  * Copyright (c) 2026 STMicroelectronics.
  * All rights reserved.
  *
  * This software is licensed under terms that can be found in the LICENSE file
  * in the root directory of this software component.
  * If no LICENSE file comes with this software, it is provided AS-IS.
  *
  ******************************************************************************
  */
/* USER CODE END Header */
#include "main.h"
#include "cmsis_os.h"

/* USER CODE BEGIN Includes */

#include <stdio.h>

#define RCC_Base		0x40021000
#define RCC_AHBENR		(*(volatile uint32_t*)(RCC_Base + 0x14))

#define GPIOE_Base		0x48001000
#define GPIOE_MODER		(*(volatile uint32_t*)(GPIOE_Base + 0x00))
#define GPIOE_ODR		(*(volatile uint32_t*)(GPIOE_Base + 0x14))

#define PORTE_EN		21
/* USER CODE END Includes */

/* USER CODE BEGIN PD */
int __io_putchar(int ch)
{
    ITM_SendChar(ch);
    return ch;
}
/* USER CODE END PD */

/* Definitions for defaultTask */
osThreadId_t defaultTaskHandle;
const osThreadAttr_t defaultTask_attributes = {
  .name = "defaultTask",
  .stack_size = 128 * 4,
  .priority = (osPriority_t) osPriorityNormal,
};
/* Definitions for PE8 */
osThreadId_t PE8Handle;
const osThreadAttr_t PE8_attributes = {
  .name = "PE8",
  .stack_size = 128 * 4,
  .priority = (osPriority_t) osPriorityLow,
};
/* Definitions for PE9 */
osThreadId_t PE9Handle;
const osThreadAttr_t PE9_attributes = {
  .name = "PE9",
  .stack_size = 128 * 4,
  .priority = (osPriority_t) osPriorityLow,
};
/* Definitions for PE10 */
osThreadId_t PE10Handle;
const osThreadAttr_t PE10_attributes = {
  .name = "PE10",
  .stack_size = 128 * 4,
  .priority = (osPriority_t) osPriorityLow,
};
/* Definitions for PE11 */
osThreadId_t PE11Handle;
const osThreadAttr_t PE11_attributes = {
  .name = "PE11",
  .stack_size = 128 * 4,
  .priority = (osPriority_t) osPriorityBelowNormal,
};
/* Definitions for PE12 */
osThreadId_t PE12Handle;
const osThreadAttr_t PE12_attributes = {
  .name = "PE12",
  .stack_size = 128 * 4,
  .priority = (osPriority_t) osPriorityNormal,
};
/* Definitions for PE13 */
osThreadId_t PE13Handle;
const osThreadAttr_t PE13_attributes = {
  .name = "PE13",
  .stack_size = 128 * 4,
  .priority = (osPriority_t) osPriorityAboveNormal,
};
/* Definitions for PE14 */
osThreadId_t PE14Handle;
const osThreadAttr_t PE14_attributes = {
  .name = "PE14",
  .stack_size = 128 * 4,
  .priority = (osPriority_t) osPriorityHigh,
};
/* Definitions for PE15 */
osThreadId_t PE15Handle;
const osThreadAttr_t PE15_attributes = {
  .name = "PE15",
  .stack_size = 128 * 4,
  .priority = (osPriority_t) osPriorityRealtime,
};

void SystemClock_Config(void);
static void MX_GPIO_Init(void);
void StartDefaultTask(void *argument);
void LED1(void *argument);
void LED2(void *argument);
void LED3(void *argument);
void LED4(void *argument);
void LED5(void *argument);
void LED6(void *argument);
void LED7(void *argument);
void LED8(void *argument);

int main(void)
{

  /* MCU Configuration--------------------------------------------------------*/

  /* Reset of all peripherals, Initializes the Flash interface and the Systick. */
  HAL_Init();

  /* USER CODE BEGIN Init */

	RCC_AHBENR |= (1 << PORTE_EN);
	GPIOE_MODER &= ~(0xFFFF << (8*2));
	GPIOE_MODER |=  (0x5555 << (8*2));

  /* USER CODE END Init */

  /* Configure the system clock */
  SystemClock_Config();

  /* Initialize all configured peripherals */
  MX_GPIO_Init();

  /* Init scheduler */
  osKernelInitialize();

  /* Create the thread(s) */
  /* creation of defaultTask */
  defaultTaskHandle = osThreadNew(StartDefaultTask, NULL, &defaultTask_attributes);

  /* creation of PE8 */
  PE8Handle = osThreadNew(LED1, NULL, &PE8_attributes);

  /* creation of PE9 */
  PE9Handle = osThreadNew(LED2, NULL, &PE9_attributes);

  /* creation of PE10 */
  PE10Handle = osThreadNew(LED3, NULL, &PE10_attributes);

  /* creation of PE11 */
  PE11Handle = osThreadNew(LED4, NULL, &PE11_attributes);

  /* creation of PE12 */
  PE12Handle = osThreadNew(LED5, NULL, &PE12_attributes);

  /* creation of PE13 */
  PE13Handle = osThreadNew(LED6, NULL, &PE13_attributes);

  /* creation of PE14 */
  PE14Handle = osThreadNew(LED7, NULL, &PE14_attributes);

  /* creation of PE15 */
  PE15Handle = osThreadNew(LED8, NULL, &PE15_attributes);

  /* Start scheduler */
  osKernelStart();

  /* We should never get here as control is now taken by the scheduler */

  /* Infinite loop */
  while (1)
  {

  }
}

void SystemClock_Config(void)
{
  RCC_OscInitTypeDef RCC_OscInitStruct = {0};
  RCC_ClkInitTypeDef RCC_ClkInitStruct = {0};

  /** Initializes the RCC Oscillators according to the specified parameters
  * in the RCC_OscInitTypeDef structure.
  */
  RCC_OscInitStruct.OscillatorType = RCC_OSCILLATORTYPE_HSE;
  RCC_OscInitStruct.HSEState = RCC_HSE_ON;
  RCC_OscInitStruct.HSEPredivValue = RCC_HSE_PREDIV_DIV1;
  RCC_OscInitStruct.HSIState = RCC_HSI_ON;
  RCC_OscInitStruct.PLL.PLLState = RCC_PLL_ON;
  RCC_OscInitStruct.PLL.PLLSource = RCC_PLLSOURCE_HSE;
  RCC_OscInitStruct.PLL.PLLMUL = RCC_PLL_MUL2;
  if (HAL_RCC_OscConfig(&RCC_OscInitStruct) != HAL_OK)
  {
    Error_Handler();
  }

  /** Initializes the CPU, AHB and APB buses clocks
  */
  RCC_ClkInitStruct.ClockType = RCC_CLOCKTYPE_HCLK|RCC_CLOCKTYPE_SYSCLK
                              |RCC_CLOCKTYPE_PCLK1|RCC_CLOCKTYPE_PCLK2;
  RCC_ClkInitStruct.SYSCLKSource = RCC_SYSCLKSOURCE_PLLCLK;
  RCC_ClkInitStruct.AHBCLKDivider = RCC_SYSCLK_DIV1;
  RCC_ClkInitStruct.APB1CLKDivider = RCC_HCLK_DIV1;
  RCC_ClkInitStruct.APB2CLKDivider = RCC_HCLK_DIV1;

  if (HAL_RCC_ClockConfig(&RCC_ClkInitStruct, FLASH_LATENCY_0) != HAL_OK)
  {
    Error_Handler();
  }
}

static void MX_GPIO_Init(void)
{

  /* GPIO Ports Clock Enable */
  __HAL_RCC_GPIOF_CLK_ENABLE();
  __HAL_RCC_GPIOA_CLK_ENABLE();

}

void StartDefaultTask(void *argument)
{
  /* USER CODE BEGIN 5 */
  /* Infinite loop */
  for(;;)
  {
	    printf("Hello\r\n");
	    osDelay(1000);

  }
  /* USER CODE END 5 */
}

void LED1(void *argument)
{
  /* USER CODE BEGIN LED1 */
  /* Infinite loop */
  for(;;)
  {
	  GPIOE_ODR |=  (1 << 8);
	  osDelay(500);
  }
  /* USER CODE END LED1 */
}

void LED2(void *argument)
{
  /* USER CODE BEGIN LED2 */
  /* Infinite loop */
  for(;;)
  {
	  GPIOE_ODR ^=  (1 << 9);
	 osDelay(500);

  }
  /* USER CODE END LED2 */
}

void LED3(void *argument)
{
  /* USER CODE BEGIN LED3 */
  /* Infinite loop */
  for(;;)
  {
	  GPIOE_ODR ^=  (1 << 10);
	 osDelay(450);
  }
  /* USER CODE END LED3 */
}

void LED4(void *argument)
{
  /* USER CODE BEGIN LED4 */
  /* Infinite loop */
  for(;;)
  {
	  GPIOE_ODR ^=  (1 << 11);
	   osDelay(400);
  }
  /* USER CODE END LED4 */
}

void LED5(void *argument)
{
  /* USER CODE BEGIN LED5 */
  /* Infinite loop */
  for(;;)
  {
	  GPIOE_ODR ^=  (1 << 12);
	  osDelay(350);
  }
  /* USER CODE END LED5 */
}

void LED6(void *argument)
{
  /* USER CODE BEGIN LED6 */
  /* Infinite loop */
  for(;;)
  {
	  GPIOE_ODR ^=  (1 << 13);
	   osDelay(530);
  }
  /* USER CODE END LED6 */
}

void LED7(void *argument)
{
  /* USER CODE BEGIN LED7 */
  /* Infinite loop */
  for(;;)
  {
	  GPIOE_ODR ^=  (1 << 14);
	  osDelay(250);
  }
  /* USER CODE END LED7 */
}

void LED8(void *argument)
{
  /* USER CODE BEGIN LED8 */
  /* Infinite loop */
  for(;;)
  {
	  GPIOE_ODR |=  (1 << 15);
	  osDelay(200);
  }
  /* USER CODE END LED8 */
}

void HAL_TIM_PeriodElapsedCallback(TIM_HandleTypeDef *htim)
{
  if (htim->Instance == TIM6)
  {
    HAL_IncTick();
  }
}

void Error_Handler(void)
{
  __disable_irq();
  while (1)
  {
  }
}
