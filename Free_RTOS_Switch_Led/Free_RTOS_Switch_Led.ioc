# file: Free_RTOS_Switch_Led.ioc
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FREERTOS.Tasks01=defaultTask,24,128,StartDefaultTask,Default,NULL,Dynamic,NULL,NULL;PE8,8,128,LED1,Default,NULL,Dynamic,NULL,NULL;PE10,32,128,LED2,Default,NULL,Dynamic,NULL,NULL
Mcu.Family=STM32F3
Mcu.Name=STM32F303V(B-C)Tx
Mcu.Package=LQFP100
NVIC.PriorityGroup=NVIC_PRIORITYGROUP_4
ProjectManager.HeapSize=0x200
ProjectManager.StackSize=0x400
ProjectManager.TargetToolchain=STM32CubeIDE
RCC.AHBFreq_Value=8000000
RCC.APB1Freq_Value=8000000
RCC.APB2Freq_Value=8000000
RCC.CortexFreq_Value=8000000
RCC.HSE_VALUE=8000000
RCC.HSI_VALUE=8000000
RCC.LSE_VALUE=32768
RCC.SYSCLKFreq_VALUE=8000000
VP_FREERTOS_VS_CMSIS_V2.Mode=CMSIS_V2
board=custom

// file: Core/Src/main.c
/* USER CODE BEGIN Header */
/**
  ******************************************************************************
  * @file           : main.c
  * @brief          : Main program body
  ******************************************************************************
  * @attention
  *
  * Copyright (c) 2026 STMicroelectronics.
  * All rights reserved.
  *
  * This software is licensed under terms that can be found in the LICENSE file
  * in the root directory of this software component.
  * If no LICENSE file comes with this software, it is provided AS-IS.
  *
  ******************************************************************************
  */
/* USER CODE END Header */
#include "main.h"
#include "cmsis_os.h"

/* USER CODE BEGIN Includes */
#define RCC_Base		0x40021000
#define RCC_AHBENR		(*(volatile uint32_t*)(RCC_Base + 0x14))

#define GPIOA_Base		0x48000000
#define GPIOA_MODER		(*(volatile uint32_t*)(GPIOA_Base + 0x00))
#define GPIOA_IDR		(*(volatile uint32_t*)(GPIOA_Base + 0x10))

#define GPIOE_Base		0x48001000
#define GPIOE_MODER		(*(volatile uint32_t*)(GPIOE_Base + 0x00))
#define GPIOE_ODR		(*(volatile uint32_t*)(GPIOE_Base + 0x14))

#define	PORTA_EN	17
#define	PORTE_EN	21

#define switch		0
#define led1		8
#define led2		10

/* USER CODE END Includes */

/* Definitions for defaultTask */
osThreadId_t defaultTaskHandle;
const osThreadAttr_t defaultTask_attributes = {
  .name = "defaultTask",
  .stack_size = 128 * 4,
  .priority = (osPriority_t) osPriorityNormal,
};
/* Definitions for PE8 */
osThreadId_t PE8Handle;
const osThreadAttr_t PE8_attributes = {
  .name = "PE8",
  .stack_size = 128 * 4,
  .priority = (osPriority_t) osPriorityLow,
};
/* Definitions for PE10 */
osThreadId_t PE10Handle;
const osThreadAttr_t PE10_attributes = {
  .name = "PE10",
  .stack_size = 128 * 4,
  .priority = (osPriority_t) osPriorityAboveNormal,
};

void SystemClock_Config(void);
void StartDefaultTask(void *argument);
void LED1(void *argument);
void LED2(void *argument);

int main(void)
{

  /* MCU Configuration--------------------------------------------------------*/

  /* Reset of all peripherals, Initializes the Flash interface and the Systick. */
  HAL_Init();

  /* USER CODE BEGIN Init */

  RCC_AHBENR |= (1<<PORTA_EN)|(1<<PORTE_EN);

  GPIOA_MODER &= ~(3<<(switch*2));

  GPIOE_MODER &= ~((3<<(led1*2))|(3<<(led2*2)));
  GPIOE_MODER |=  ((1<<(led1*2))|(1<<(led2*2)));

  /* USER CODE END Init */

  /* Configure the system clock */
  SystemClock_Config();

  /* Initialize all configured peripherals */

  /* Init scheduler */
  osKernelInitialize();

  /* Create the thread(s) */
  /* creation of defaultTask */
  defaultTaskHandle = osThreadNew(StartDefaultTask, NULL, &defaultTask_attributes);

  /* creation of PE8 */
  PE8Handle = osThreadNew(LED1, NULL, &PE8_attributes);

  /* creation of PE10 */
  PE10Handle = osThreadNew(LED2, NULL, &PE10_attributes);

  /* Start scheduler */
  osKernelStart();

  /* We should never get here as control is now taken by the scheduler */

  /* Infinite loop */
  while (1)
  {

  }
}

void SystemClock_Config(void)
{
  RCC_OscInitTypeDef RCC_OscInitStruct = {0};
  RCC_ClkInitTypeDef RCC_ClkInitStruct = {0};

  /** Initializes the RCC Oscillators according to the specified parameters
  * in the RCC_OscInitTypeDef structure.
  */
  RCC_OscInitStruct.OscillatorType = RCC_OSCILLATORTYPE_HSI;
  RCC_OscInitStruct.HSIState = RCC_HSI_ON;
  RCC_OscInitStruct.HSICalibrationValue = RCC_HSICALIBRATION_DEFAULT;
  RCC_OscInitStruct.PLL.PLLState = RCC_PLL_NONE;
  if (HAL_RCC_OscConfig(&RCC_OscInitStruct) != HAL_OK)
  {
    Error_Handler();
  }

  /** Initializes the CPU, AHB and APB buses clocks
  */
  RCC_ClkInitStruct.ClockType = RCC_CLOCKTYPE_HCLK|RCC_CLOCKTYPE_SYSCLK
                              |RCC_CLOCKTYPE_PCLK1|RCC_CLOCKTYPE_PCLK2;
  RCC_ClkInitStruct.SYSCLKSource = RCC_SYSCLKSOURCE_HSI;
  RCC_ClkInitStruct.AHBCLKDivider = RCC_SYSCLK_DIV1;
  RCC_ClkInitStruct.APB1CLKDivider = RCC_HCLK_DIV1;
  RCC_ClkInitStruct.APB2CLKDivider = RCC_HCLK_DIV1;

  if (HAL_RCC_ClockConfig(&RCC_ClkInitStruct, FLASH_LATENCY_0) != HAL_OK)
  {
    Error_Handler();
  }
}

void StartDefaultTask(void *argument)
{
  for(;;)
  {
    osDelay(1);
  }
}

void LED1(void *argument)
{
  /* USER CODE BEGIN LED1 */
  /* Infinite loop */
  for(;;)
  {
	  GPIOE_ODR ^= (1 << led1);
    osDelay(500);
  }
  /* USER CODE END LED1 */
}

void LED2(void *argument)
{
  /* USER CODE BEGIN LED2 */
  /* Infinite loop */
  for(;;)
  {
	  if(GPIOA_IDR & (1<<0))
	  {
		  while(1)
		  {
		  GPIOE_ODR |= (1 << led2);
		  osDelay(1000);
		  GPIOE_ODR &= ~(1 << led2);
		  osDelay(500);
		  }
	  }
    osDelay(1);
  }
  /* USER CODE END LED2 */
}

void Error_Handler(void)
{
  __disable_irq();
  while (1)
  {
  }
}
