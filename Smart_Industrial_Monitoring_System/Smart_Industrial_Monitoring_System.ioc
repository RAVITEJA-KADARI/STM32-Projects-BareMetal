# file: Smart_Industrial_Monitoring_System.ioc
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FREERTOS.Queues01=Sensorqueue,16,uint16_t,0,Dynamic,NULL,NULL
FREERTOS.Tasks01=SensorTask,48,128,StartSensorTask,Default,NULL,Dynamic,NULL,NULL;LogicTask,32,128,StartLogicTask,Default,NULL,Dynamic,NULL,NULL;DisplayTask,24,128,StartDisplayTask,Default,NULL,Dynamic,NULL,NULL;AlarmTask,16,128,StartAlarmTask,Default,NULL,Dynamic,NULL,NULL;LoggerTask,8,128,StartLoggerTask,Default,NULL,Dynamic,NULL,NULL
FREERTOS.configTOTAL_HEAP_SIZE=4000
Mcu.Family=STM32F3
Mcu.Name=STM32F303V(B-C)Tx
Mcu.Package=LQFP100
NVIC.PriorityGroup=NVIC_PRIORITYGROUP_4
NVIC.TIM1_UP_TIM16_IRQn=true\:15\:0\:false\:false\:true\:false\:false\:true\:true
NVIC.TimeBase=TIM1_UP_TIM16_IRQn
NVIC.TimeBaseIP=TIM1
PA13.Mode=Serial_Wire
PA13.Signal=SYS_JTMS-SWDIO
PA14.Mode=Serial_Wire
PA14.Signal=SYS_JTCK-SWCLK
ProjectManager.HeapSize=0x200
ProjectManager.StackSize=0x400
ProjectManager.TargetToolchain=STM32CubeIDE
RCC.AHBFreq_Value=8000000
RCC.APB1Freq_Value=8000000
RCC.APB2Freq_Value=8000000
RCC.CortexFreq_Value=8000000
RCC.HSE_VALUE=8000000
RCC.HSI_VALUE=8000000
RCC.LSE_VALUE=32768
RCC.SYSCLKFreq_VALUE=8000000
VP_FREERTOS_VS_CMSIS_V2.Mode=CMSIS_V2
VP_SYS_VS_tim1.Mode=TIM1
board=custom

// file: Core/Src/main.c
/* USER CODE BEGIN Header */
/**
  ******************************************************************************
  * @file           : main.c
  * @brief          : Main program body
  ******************************************************************************
  * @attention
  *
  * Copyright (c) 2026 STMicroelectronics.
  * All rights reserved.
  *
  * This software is licensed under terms that can be found in the LICENSE file
  * in the root directory of this software component.
  * If no LICENSE file comes with this software, it is provided AS-IS.
  *
  ******************************************************************************
  */
/* USER CODE END Header */
#include "main.h"
#include "cmsis_os.h"

/* USER CODE BEGIN Includes */

#include <stdio.h>
#include <stm32f303_reg.h>
#include <lcd.h>
#include <adc.h>
#include <uart.h>
#include <buzzer.h>

/* USER CODE END Includes */

/* USER CODE BEGIN PD */

#define SAFE 0
#define WARNING 1
#define DANGER 2

volatile uint32_t latest_adc = 0;
volatile uint8_t system_state = SAFE;

/* USER CODE END PD */

/* Definitions for SensorTask */
osThreadId_t SensorTaskHandle;
const osThreadAttr_t SensorTask_attributes = {
  .name = "SensorTask",
  .stack_size = 128 * 4,
  .priority = (osPriority_t) osPriorityRealtime,
};
/* Definitions for LogicTask */
osThreadId_t LogicTaskHandle;
const osThreadAttr_t LogicTask_attributes = {
  .name = "LogicTask",
  .stack_size = 128 * 4,
  .priority = (osPriority_t) osPriorityAboveNormal,
};
/* Definitions for DisplayTask */
osThreadId_t DisplayTaskHandle;
const osThreadAttr_t DisplayTask_attributes = {
  .name = "DisplayTask",
  .stack_size = 128 * 4,
  .priority = (osPriority_t) osPriorityNormal,
};
/* Definitions for AlarmTask */
osThreadId_t AlarmTaskHandle;
const osThreadAttr_t AlarmTask_attributes = {
  .name = "AlarmTask",
  .stack_size = 128 * 4,
  .priority = (osPriority_t) osPriorityBelowNormal,
};
/* Definitions for LoggerTask */
osThreadId_t LoggerTaskHandle;
const osThreadAttr_t LoggerTask_attributes = {
  .name = "LoggerTask",
  .stack_size = 128 * 4,
  .priority = (osPriority_t) osPriorityLow,
};
/* Definitions for Sensorqueue */
osMessageQueueId_t SensorqueueHandle;
const osMessageQueueAttr_t Sensorqueue_attributes = {
  .name = "Sensorqueue"
};

void SystemClock_Config(void);
static void MX_GPIO_Init(void);
void StartSensorTask(void *argument);
void StartLogicTask(void *argument);
void StartDisplayTask(void *argument);
void StartAlarmTask(void *argument);
void StartLoggerTask(void *argument);

int main(void)
{

  /* MCU Configuration--------------------------------------------------------*/

  /* Reset of all peripherals, Initializes the Flash interface and the Systick. */
  HAL_Init();

  /* Configure the system clock */
  SystemClock_Config();

  /* Initialize all configured peripherals */
  MX_GPIO_Init();
  osDelay(50);
  /* USER CODE BEGIN 2 */

  I2C1_init();
  LCD_init();
  adc1_init();
  usart1_init();

  gpio_buzzer_init();

  /* USER CODE END 2 */

  /* Init scheduler */
  osKernelInitialize();

  /* Create the queue(s) */
  /* creation of Sensorqueue */
  SensorqueueHandle = osMessageQueueNew (16, sizeof(uint16_t), &Sensorqueue_attributes);

  /* Create the thread(s) */
  /* creation of SensorTask */
  SensorTaskHandle = osThreadNew(StartSensorTask, NULL, &SensorTask_attributes);

  /* creation of LogicTask */
  LogicTaskHandle = osThreadNew(StartLogicTask, NULL, &LogicTask_attributes);

  /* creation of DisplayTask */
  DisplayTaskHandle = osThreadNew(StartDisplayTask, NULL, &DisplayTask_attributes);

  /* creation of AlarmTask */
  AlarmTaskHandle = osThreadNew(StartAlarmTask, NULL, &AlarmTask_attributes);

  /* creation of LoggerTask */
  LoggerTaskHandle = osThreadNew(StartLoggerTask, NULL, &LoggerTask_attributes);

  /* USER CODE BEGIN RTOS
   * _EVENTS */
  /* add events, ... */
   usart1_print("System Booting...\r\n");
   usart1_print("Smart Industrial Monitoring System\r\n");
   usart1_print("UART Initialized OK\r\n");

  /* USER CODE END RTOS_EVENTS */

  /* Start scheduler */
  osKernelStart();

  /* We should never get here as control is now taken by the scheduler */

  /* Infinite loop */
  while (1)
  {

  }
}

void SystemClock_Config(void)
{
  RCC_OscInitTypeDef RCC_OscInitStruct = {0};
  RCC_ClkInitTypeDef RCC_ClkInitStruct = {0};

  /** Initializes the RCC Oscillators according to the specified parameters
  * in the RCC_OscInitTypeDef structure.
  */
  RCC_OscInitStruct.OscillatorType = RCC_OSCILLATORTYPE_HSI;
  RCC_OscInitStruct.HSIState = RCC_HSI_ON;
  RCC_OscInitStruct.HSICalibrationValue = RCC_HSICALIBRATION_DEFAULT;
  RCC_OscInitStruct.PLL.PLLState = RCC_PLL_NONE;
  if (HAL_RCC_OscConfig(&RCC_OscInitStruct) != HAL_OK)
  {
    Error_Handler();
  }

  /** Initializes the CPU, AHB and APB buses clocks
  */
  RCC_ClkInitStruct.ClockType = RCC_CLOCKTYPE_HCLK|RCC_CLOCKTYPE_SYSCLK
                              |RCC_CLOCKTYPE_PCLK1|RCC_CLOCKTYPE_PCLK2;
  RCC_ClkInitStruct.SYSCLKSource = RCC_SYSCLKSOURCE_HSI;
  RCC_ClkInitStruct.AHBCLKDivider = RCC_SYSCLK_DIV1;
  RCC_ClkInitStruct.APB1CLKDivider = RCC_HCLK_DIV1;
  RCC_ClkInitStruct.APB2CLKDivider = RCC_HCLK_DIV1;

  if (HAL_RCC_ClockConfig(&RCC_ClkInitStruct, FLASH_LATENCY_0) != HAL_OK)
  {
    Error_Handler();
  }
}

static void MX_GPIO_Init(void)
{

  /* GPIO Ports Clock Enable */
  __HAL_RCC_GPIOA_CLK_ENABLE();

}

void StartSensorTask(void *argument)
{
    uint32_t val;

    for(;;)
    {
        val = adc1_read();

        latest_adc = val;   // store globally (IMPORTANT FIX)

        osMessageQueuePut(SensorqueueHandle, &val, 0, 0);

        osDelay(50);
    }
}

void StartLogicTask(void *argument)
{
    uint32_t val;

    for(;;)
    {
        if(osMessageQueueGet(SensorqueueHandle, &val, NULL, osWaitForever) == osOK)
        {
            if(val >= 400)
                system_state = DANGER;
            else if(val >= 300)
                system_state = WARNING;
            else
                system_state = SAFE;
        }
    }
}

void StartDisplayTask(void *argument)
{
    uint8_t boot_done = 0;

    for(;;)
    {
        if(boot_done == 0)
        {
            LCD_cmd(0x01);
            LCD_cmd(0x80);
            LCD_string("Smart Industrial");

            LCD_cmd(0xC0);
            LCD_string("Monitoring Sys..");

            osDelay(2000);
            LCD_cmd(0x01);

            boot_done = 1;
        }

        // USE GLOBAL VARIABLE
        LCD_cmd(0x80);
        LCD_string("ADC:   ");
        LCD_cmd(0x84);

        uint32_t val = latest_adc;

        LCD_data((val / 1000) + '0');
        LCD_data((val / 100) % 10 + '0');
        LCD_data((val / 10) % 10 + '0');
        LCD_data(val % 10 + '0');

        osDelay(200);
    }
}

void StartAlarmTask(void *argument)
{

  /* USER CODE BEGIN StartAlarmTask */
  /* Infinite loop */
	 for(;;)
	  {
	    if(system_state == DANGER)
	    {
	        GPIOB_ODR |= (1 << 5);
	    }
	    else if(system_state == WARNING)
	    {
	        GPIOB_ODR ^= (1 << 5);
	        osDelay(100);
	    }
	    else
	    {
	        GPIOB_ODR &= ~(1 << 5);
	    }

	    osDelay(50);
	  }
  /* USER CODE END StartAlarmTask */
}

void StartLoggerTask(void *argument)
{
    uint32_t val;
    char buffer[80];

    usart1_print("Logger Task Started\r\n");

    for(;;)
    {
        if(osMessageQueueGet(SensorqueueHandle, &val, NULL, osWaitForever) == osOK)
        {
            sprintf(buffer, "ADC Value: %lu\r\n", val);
            usart1_print(buffer);

            if(val >= 400)
                usart1_print("STATE: DANGER\r\n");
            else if(val >= 300)
                usart1_print("STATE: WARNING\r\n");
            else
                usart1_print("STATE: SAFE\r\n");
        }
    }
}
void HAL_TIM_PeriodElapsedCallback(TIM_HandleTypeDef *htim)
{
  if (htim->Instance == TIM1)
  {
    HAL_IncTick();
  }
}

void Error_Handler(void)
{
  __disable_irq();
  while (1)
  {
  }
}
